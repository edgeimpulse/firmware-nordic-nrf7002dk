## CMakeLists.txt
```
# /* The Clear BSD License
#  *
#  * Copyright (c) 2025 EdgeImpulse Inc.
#  * All rights reserved.
#  *
#  * Redistribution and use in source and binary forms, with or without
#  * modification, are permitted (subject to the limitations in the disclaimer
#  * below) provided that the following conditions are met:
#  *
#  *   * Redistributions of source code must retain the above copyright notice,
#  *   this list of conditions and the following disclaimer.
#  *
#  *   * Redistributions in binary form must reproduce the above copyright
#  *   notice, this list of conditions and the following disclaimer in the
#  *   documentation and/or other materials provided with the distribution.
#  *
#  *   * Neither the name of the copyright holder nor the names of its
#  *   contributors may be used to endorse or promote products derived from this
#  *   software without specific prior written permission.
#  *
#  * NO EXPRESS OR IMPLIED LICENSES TO ANY PARTY'S PATENT RIGHTS ARE GRANTED BY
#  * THIS LICENSE. THIS SOFTWARE IS PROVIDED BY THE COPYRIGHT HOLDERS AND
#  * CONTRIBUTORS "AS IS" AND ANY EXPRESS OR IMPLIED WARRANTIES, INCLUDING, BUT NOT
#  * LIMITED TO, THE IMPLIED WARRANTIES OF MERCHANTABILITY AND FITNESS FOR A
#  * PARTICULAR PURPOSE ARE DISCLAIMED. IN NO EVENT SHALL THE COPYRIGHT HOLDER OR
#  * CONTRIBUTORS BE LIABLE FOR ANY DIRECT, INDIRECT, INCIDENTAL, SPECIAL,
#  * EXEMPLARY, OR CONSEQUENTIAL DAMAGES (INCLUDING, BUT NOT LIMITED TO,
#  * PROCUREMENT OF SUBSTITUTE GOODS OR SERVICES; LOSS OF USE, DATA, OR PROFITS; OR
#  * BUSINESS INTERRUPTION) HOWEVER CAUSED AND ON ANY THEORY OF LIABILITY, WHETHER
#  * IN CONTRACT, STRICT LIABILITY, OR TORT (INCLUDING NEGLIGENCE OR OTHERWISE)
#  * ARISING IN ANY WAY OUT OF THE USE OF THIS SOFTWARE, EVEN IF ADVISED OF THE
#  * POSSIBILITY OF SUCH DAMAGE.
#  */

cmake_minimum_required(VERSION 3.13.1)

set(PM_STATIC_YML_FILE ${CMAKE_CURRENT_SOURCE_DIR}/boards/pm_static_${BOARD}.yml)
set(CMAKE_CXX_STANDARD 11)
set(CMAKE_CXX_STANDARD_REQUIRED ON)

# This firmware uses X-Nucleo IKS02A1 shield
set(SHIELD x_nucleo_iks02a1)

find_package(Zephyr REQUIRED HINTS $ENV{ZEPHYR_BASE})
project("firmware-nordic-nrf7002dk"
          VERSION 0.1)

# Needed for colorful output
zephyr_compile_options(-fdiagnostics-color=always)

# Use hardware acceleration for DSP and Neural Network code
# You'll need to disable these on non-Arm cores
add_definitions(-DEIDSP_USE_CMSIS_DSP=1
                -DEIDSP_LOAD_CMSIS_DSP_SOURCES=1
                -DEI_CLASSIFIER_TFLITE_ENABLE_CMSIS_NN=1
                -DEIDSP_QUANTIZE_FILTERBANK=0
                -DARM_MATH_LOOPUNROLL
                -DMBEDTLS_PLATFORM_ZEROIZE_ALT
                )

# Add all required source files
add_subdirectory(ei-model/edge-impulse-sdk/cmake/zephyr)
add_subdirectory(firmware-sdk)
add_subdirectory(src/wifi)
add_subdirectory(src/inference)
add_subdirectory(src/sensors)
add_subdirectory(src)

# Include directories (everything in the SDK is already included here)
target_include_directories(app PRIVATE .)
target_include_directories(app PRIVATE ei-model)

# Use GLOB to include model files, because model file names differes whether model is EON compiled or not
RECURSIVE_FIND_FILE(MODEL_FILES ei-model/tflite-model "*.cpp")
target_sources(app PRIVATE ${MODEL_FILES})
```

## Kconfig
```
# /* The Clear BSD License
#  *
#  * Copyright (c) 2025 EdgeImpulse Inc.
#  * All rights reserved.
#  *
#  * Redistribution and use in source and binary forms, with or without
#  * modification, are permitted (subject to the limitations in the disclaimer
#  * below) provided that the following conditions are met:
#  *
#  *   * Redistributions of source code must retain the above copyright notice,
#  *   this list of conditions and the following disclaimer.
#  *
#  *   * Redistributions in binary form must reproduce the above copyright
#  *   notice, this list of conditions and the following disclaimer in the
#  *   documentation and/or other materials provided with the distribution.
#  *
#  *   * Neither the name of the copyright holder nor the names of its
#  *   contributors may be used to endorse or promote products derived from this
#  *   software without specific prior written permission.
#  *
#  * NO EXPRESS OR IMPLIED LICENSES TO ANY PARTY'S PATENT RIGHTS ARE GRANTED BY
#  * THIS LICENSE. THIS SOFTWARE IS PROVIDED BY THE COPYRIGHT HOLDERS AND
#  * CONTRIBUTORS "AS IS" AND ANY EXPRESS OR IMPLIED WARRANTIES, INCLUDING, BUT NOT
#  * LIMITED TO, THE IMPLIED WARRANTIES OF MERCHANTABILITY AND FITNESS FOR A
#  * PARTICULAR PURPOSE ARE DISCLAIMED. IN NO EVENT SHALL THE COPYRIGHT HOLDER OR
#  * CONTRIBUTORS BE LIABLE FOR ANY DIRECT, INDIRECT, INCIDENTAL, SPECIAL,
#  * EXEMPLARY, OR CONSEQUENTIAL DAMAGES (INCLUDING, BUT NOT LIMITED TO,
#  * PROCUREMENT OF SUBSTITUTE GOODS OR SERVICES; LOSS OF USE, DATA, OR PROFITS; OR
#  * BUSINESS INTERRUPTION) HOWEVER CAUSED AND ON ANY THEORY OF LIABILITY, WHETHER
#  * IN CONTRACT, STRICT LIABILITY, OR TORT (INCLUDING NEGLIGENCE OR OTHERWISE)
#  * ARISING IN ANY WAY OUT OF THE USE OF THIS SOFTWARE, EVEN IF ADVISED OF THE
#  * POSSIBILITY OF SUCH DAMAGE.
#  */

source "Kconfig.zephyr"

menu "Edge Impulse nRF7002DK example"

config EI_INFERENCE_THREAD_STACK
    int "Inference thread stack size"
    default 256
    help
      "Set the Edge Impulse inference thread stack size."

config EI_INFERENCE_THREAD_PRIO
    int "Inference thread priority"
    default 5
    help
      "Set the Edge Impulse inference thread priority. The lower number, the higher prority."

module = REMOTE_INGESTION
module-str = Remote Ingestion
source "subsys/logging/Kconfig.template.log_config"

endmenu
```

## prj.conf
```kconfig
# /* The Clear BSD License
#  *
#  * Copyright (c) 2025 EdgeImpulse Inc.
#  * All rights reserved.
#  *
#  * Redistribution and use in source and binary forms, with or without
#  * modification, are permitted (subject to the limitations in the disclaimer
#  * below) provided that the following conditions are met:
#  *
#  *   * Redistributions of source code must retain the above copyright notice,
#  *   this list of conditions and the following disclaimer.
#  *
#  *   * Redistributions in binary form must reproduce the above copyright
#  *   notice, this list of conditions and the following disclaimer in the
#  *   documentation and/or other materials provided with the distribution.
#  *
#  *   * Neither the name of the copyright holder nor the names of its
#  *   contributors may be used to endorse or promote products derived from this
#  *   software without specific prior written permission.
#  *
#  * NO EXPRESS OR IMPLIED LICENSES TO ANY PARTY'S PATENT RIGHTS ARE GRANTED BY
#  * THIS LICENSE. THIS SOFTWARE IS PROVIDED BY THE COPYRIGHT HOLDERS AND
#  * CONTRIBUTORS "AS IS" AND ANY EXPRESS OR IMPLIED WARRANTIES, INCLUDING, BUT NOT
#  * LIMITED TO, THE IMPLIED WARRANTIES OF MERCHANTABILITY AND FITNESS FOR A
#  * PARTICULAR PURPOSE ARE DISCLAIMED. IN NO EVENT SHALL THE COPYRIGHT HOLDER OR
#  * CONTRIBUTORS BE LIABLE FOR ANY DIRECT, INDIRECT, INCIDENTAL, SPECIAL,
#  * EXEMPLARY, OR CONSEQUENTIAL DAMAGES (INCLUDING, BUT NOT LIMITED TO,
#  * PROCUREMENT OF SUBSTITUTE GOODS OR SERVICES; LOSS OF USE, DATA, OR PROFITS; OR
#  * BUSINESS INTERRUPTION) HOWEVER CAUSED AND ON ANY THEORY OF LIABILITY, WHETHER
#  * IN CONTRACT, STRICT LIABILITY, OR TORT (INCLUDING NEGLIGENCE OR OTHERWISE)
#  * ARISING IN ANY WAY OUT OF THE USE OF THIS SOFTWARE, EVEN IF ADVISED OF THE
#  * POSSIBILITY OF SUCH DAMAGE.
#  */
################################################################################
# Application configuration
CONFIG_GPIO=y

# Enable c++ support
CONFIG_CPLUSPLUS=y
CONFIG_STD_CPP11=y
CONFIG_LIB_CPLUSPLUS=y
CONFIG_NEWLIB_LIBC=y
CONFIG_NEWLIB_LIBC_FLOAT_PRINTF=y
CONFIG_NEWLIB_LIBC_NANO=n

# Enable reboot from user space
CONFIG_REBOOT=y

# Enable floating point unit
CONFIG_FPU=y

CONFIG_MAIN_STACK_SIZE=8192
CONFIG_SYSTEM_WORKQUEUE_STACK_SIZE=4096
CONFIG_EI_INFERENCE_THREAD_STACK=4096
CONFIG_HEAP_MEM_POOL_SIZE=170000

# Serial console
CONFIG_UART_INTERRUPT_DRIVEN=y
CONFIG_CONSOLE_SUBSYS=n

CONFIG_DK_LIBRARY=n
# Using built-in sensor
CONFIG_SENSOR=y

# I2C configuration for accelerometer
CONFIG_I2C=y
CONFIG_I2C_NRFX=y

CONFIG_ASSERT=y
CONFIG_DEBUG=y
CONFIG_LOG=y
CONFIG_LOG_MODE_DEFERRED=y
CONFIG_USE_SEGGER_RTT=y
CONFIG_LOG_BACKEND_RTT=y
CONFIG_LOG_BACKEND_UART=n

# Configure Segger RTT
CONFIG_SEGGER_RTT_BUFFER_SIZE_UP=4096

# Configure bluetooth
CONFIG_BT=y

CONFIG_SETTINGS=y
CONFIG_CJSON_LIB=y

# External Flash memory
CONFIG_SPI=y
CONFIG_FLASH=y
CONFIG_PM_DEVICE=y
CONFIG_FLASH_PAGE_LAYOUT=y
CONFIG_MPU_ALLOW_FLASH_WRITE=y

CONFIG_NVS=y

CONFIG_STREAM_FLASH=y
CONFIG_FLASH_MAP=y
CONFIG_SETTINGS_NVS=y
CONFIG_SPI_NOR_FLASH_LAYOUT_PAGE_SIZE=4096

CONFIG_BOOTLOADER_MCUBOOT=y

CONFIG_ZCBOR=y
CONFIG_ZCBOR_STOP_ON_ERROR=y

# Kernel options
CONFIG_ENTROPY_GENERATOR=y
CONFIG_POSIX_CLOCK=y
CONFIG_PM=y
```

## boards/nrf7002dk_nrf5340_cpuapp.conf
```kconfig
# /* The Clear BSD License
#  *
#  * Copyright (c) 2025 EdgeImpulse Inc.
#  * All rights reserved.
#  *
#  * Redistribution and use in source and binary forms, with or without
#  * modification, are permitted (subject to the limitations in the disclaimer
#  * below) provided that the following conditions are met:
#  *
#  *   * Redistributions of source code must retain the above copyright notice,
#  *   this list of conditions and the following disclaimer.
#  *
#  *   * Redistributions in binary form must reproduce the above copyright
#  *   notice, this list of conditions and the following disclaimer in the
#  *   documentation and/or other materials provided with the distribution.
#  *
#  *   * Neither the name of the copyright holder nor the names of its
#  *   contributors may be used to endorse or promote products derived from this
#  *   software without specific prior written permission.
#  *
#  * NO EXPRESS OR IMPLIED LICENSES TO ANY PARTY'S PATENT RIGHTS ARE GRANTED BY
#  * THIS LICENSE. THIS SOFTWARE IS PROVIDED BY THE COPYRIGHT HOLDERS AND
#  * CONTRIBUTORS "AS IS" AND ANY EXPRESS OR IMPLIED WARRANTIES, INCLUDING, BUT NOT
#  * LIMITED TO, THE IMPLIED WARRANTIES OF MERCHANTABILITY AND FITNESS FOR A
#  * PARTICULAR PURPOSE ARE DISCLAIMED. IN NO EVENT SHALL THE COPYRIGHT HOLDER OR
#  * CONTRIBUTORS BE LIABLE FOR ANY DIRECT, INDIRECT, INCIDENTAL, SPECIAL,
#  * EXEMPLARY, OR CONSEQUENTIAL DAMAGES (INCLUDING, BUT NOT LIMITED TO,
#  * PROCUREMENT OF SUBSTITUTE GOODS OR SERVICES; LOSS OF USE, DATA, OR PROFITS; OR
#  * BUSINESS INTERRUPTION) HOWEVER CAUSED AND ON ANY THEORY OF LIABILITY, WHETHER
#  * IN CONTRACT, STRICT LIABILITY, OR TORT (INCLUDING NEGLIGENCE OR OTHERWISE)
#  * ARISING IN ANY WAY OUT OF THE USE OF THIS SOFTWARE, EVEN IF ADVISED OF THE
#  * POSSIBILITY OF SUCH DAMAGE.
#  */
#
#################################################################################
# WIFI configuration
#
# Networking config
CONFIG_NETWORKING=y
CONFIG_NET_IPV4=y
CONFIG_NET_IPV6=n
CONFIG_NET_TCP=y
CONFIG_NET_UDP=y
CONFIG_NET_DHCPV4=y

# Sockets
CONFIG_NET_SOCKETS=y
CONFIG_NET_SOCKETS_POLL_MAX=4

# HTTP & Websocket
CONFIG_HTTP_CLIENT=y
CONFIG_WEBSOCKET_CLIENT=y

# Network debug config
CONFIG_NET_LOG=y
CONFIG_REMOTE_INGESTION_LOG_LEVEL_DBG=y
CONFIG_REMOTE_INGESTION_LOG_LEVEL_INF=n

# These configs are useful for debugging the WiFi, but they can be disabled
# CONFIG_NET_SOCKETS_LOG_LEVEL_DBG=y
# CONFIG_NET_HTTP_LOG_LEVEL_DBG=y
# CONFIG_NET_WEBSOCKET_LOG_LEVEL_DBG=y
# CONFIG_NET_CONTEXT_LOG_LEVEL_DBG=y
# CONFIG_NET_TCP_LOG_LEVEL_DBG=y

CONFIG_NET_MAX_CONN=8
CONFIG_NET_MAX_CONTEXTS=10

CONFIG_DEBUG_INFO=y
CONFIG_DEBUG_THREAD_INFO=y
CONFIG_DEBUG_COREDUMP=n

CONFIG_WIFI=y
CONFIG_WIFI_NRF700X=y

# WPA supplicant
CONFIG_WPA_SUPP=y

CONFIG_NET_PKT_RX_COUNT=30
CONFIG_NET_PKT_TX_COUNT=10

CONFIG_NRF700X_AP_MODE=n
CONFIG_NRF700X_P2P_MODE=n

# Below section is the primary contributor to SRAM and is currently
# tuned for performance, but this will be revisited in the future.
CONFIG_NET_BUF_RX_COUNT=10
CONFIG_NET_BUF_TX_COUNT=40
CONFIG_NRF700X_RX_NUM_BUFS=10
CONFIG_NET_BUF_DATA_SIZE=512
CONFIG_NET_TC_TX_COUNT=1

CONFIG_NET_IF_UNICAST_IPV4_ADDR_COUNT=1
CONFIG_NET_CONTEXT_SYNC_RECV=y

CONFIG_INIT_STACKS=y

CONFIG_NET_L2_ETHERNET=y

# Memories
CONFIG_NET_TX_STACK_SIZE=4096
CONFIG_NET_RX_STACK_SIZE=4096

# printing of scan results puts pressure on queues in new locking
# design in net_mgmt. So, use a higher timeout for a crowded
# environment.
CONFIG_NET_MGMT_EVENT_QUEUE_TIMEOUT=5000

# Zephyr NET Connection Manager Connectivity layer.
CONFIG_NET_L2_WIFI_MGMT=y

# DNS
CONFIG_DNS_RESOLVER=y

CONFIG_POSIX_MAX_FDS=12
```

## boards/nrf7002dk_nrf5340_cpuapp.overlay
```dts
/* The Clear BSD License
 *
 * Copyright (c) 2025 EdgeImpulse Inc.
 * All rights reserved.
 *
 * Redistribution and use in source and binary forms, with or without
 * modification, are permitted (subject to the limitations in the disclaimer
 * below) provided that the following conditions are met:
 *
 *   * Redistributions of source code must retain the above copyright notice,
 *   this list of conditions and the following disclaimer.
 *
 *   * Redistributions in binary form must reproduce the above copyright
 *   notice, this list of conditions and the following disclaimer in the
 *   documentation and/or other materials provided with the distribution.
 *
 *   * Neither the name of the copyright holder nor the names of its
 *   contributors may be used to endorse or promote products derived from this
 *   software without specific prior written permission.
 *
 * NO EXPRESS OR IMPLIED LICENSES TO ANY PARTY'S PATENT RIGHTS ARE GRANTED BY
 * THIS LICENSE. THIS SOFTWARE IS PROVIDED BY THE COPYRIGHT HOLDERS AND
 * CONTRIBUTORS "AS IS" AND ANY EXPRESS OR IMPLIED WARRANTIES, INCLUDING, BUT NOT
 * LIMITED TO, THE IMPLIED WARRANTIES OF MERCHANTABILITY AND FITNESS FOR A
 * PARTICULAR PURPOSE ARE DISCLAIMED. IN NO EVENT SHALL THE COPYRIGHT HOLDER OR
 * CONTRIBUTORS BE LIABLE FOR ANY DIRECT, INDIRECT, INCIDENTAL, SPECIAL,
 * EXEMPLARY, OR CONSEQUENTIAL DAMAGES (INCLUDING, BUT NOT LIMITED TO,
 * PROCUREMENT OF SUBSTITUTE GOODS OR SERVICES; LOSS OF USE, DATA, OR PROFITS; OR
 * BUSINESS INTERRUPTION) HOWEVER CAUSED AND ON ANY THEORY OF LIABILITY, WHETHER
 * IN CONTRACT, STRICT LIABILITY, OR TORT (INCLUDING NEGLIGENCE OR OTHERWISE)
 * ARISING IN ANY WAY OUT OF THE USE OF THIS SOFTWARE, EVEN IF ADVISED OF THE
 * POSSIBILITY OF SUCH DAMAGE.
 */

&i2c1 {
    clock-frequency = <I2C_BITRATE_FAST>;
};

/ {
    chosen {
        nordic,pm-ext-flash = &mx25r64;
    };
};

&clock {
    hfclkaudio-frequency = <12288000>;
};
```

## src/main.cpp
```c
/* The Clear BSD License
 *
 * Copyright (c) 2025 EdgeImpulse Inc.
 * All rights reserved.
 *
 * Redistribution and use in source and binary forms, with or without
 * modification, are permitted (subject to the limitations in the disclaimer
 * below) provided that the following conditions are met:
 *
 *   * Redistributions of source code must retain the above copyright notice,
 *   this list of conditions and the following disclaimer.
 *
 *   * Redistributions in binary form must reproduce the above copyright
 *   notice, this list of conditions and the following disclaimer in the
 *   documentation and/or other materials provided with the distribution.
 *
 *   * Neither the name of the copyright holder nor the names of its
 *   contributors may be used to endorse or promote products derived from this
 *   software without specific prior written permission.
 *
 * NO EXPRESS OR IMPLIED LICENSES TO ANY PARTY'S PATENT RIGHTS ARE GRANTED BY
 * THIS LICENSE. THIS SOFTWARE IS PROVIDED BY THE COPYRIGHT HOLDERS AND
 * CONTRIBUTORS "AS IS" AND ANY EXPRESS OR IMPLIED WARRANTIES, INCLUDING, BUT NOT
 * LIMITED TO, THE IMPLIED WARRANTIES OF MERCHANTABILITY AND FITNESS FOR A
 * PARTICULAR PURPOSE ARE DISCLAIMED. IN NO EVENT SHALL THE COPYRIGHT HOLDER OR
 * CONTRIBUTORS BE LIABLE FOR ANY DIRECT, INDIRECT, INCIDENTAL, SPECIAL,
 * EXEMPLARY, OR CONSEQUENTIAL DAMAGES (INCLUDING, BUT NOT LIMITED TO,
 * PROCUREMENT OF SUBSTITUTE GOODS OR SERVICES; LOSS OF USE, DATA, OR PROFITS; OR
 * BUSINESS INTERRUPTION) HOWEVER CAUSED AND ON ANY THEORY OF LIABILITY, WHETHER
 * IN CONTRACT, STRICT LIABILITY, OR TORT (INCLUDING NEGLIGENCE OR OTHERWISE)
 * ARISING IN ANY WAY OUT OF THE USE OF THIS SOFTWARE, EVEN IF ADVISED OF THE
 * POSSIBILITY OF SUCH DAMAGE.
 */

#include "ei_at_handlers.h"
#include "ei_device_nordic_nrf7002dk.h"
#include "edge-impulse-sdk/porting/ei_classifier_porting.h"
#include "inference/ei_run_impulse.h"
#include "sensors/ei_inertial_sensor.h"
#include "wifi/wifi.h"
#include "wifi/ei_ws_client.h"
#include <zephyr/drivers/uart.h>
#include <zephyr/logging/log.h>
#include <nrfx_clock.h>
#include <zephyr/kernel.h>
#include <zephyr/bluetooth/bluetooth.h>

#define LOG_MODULE_NAME main
LOG_MODULE_REGISTER(LOG_MODULE_NAME);

int main(void)
{
    EiDeviceNRF7002DK *dev = static_cast<EiDeviceNRF7002DK*>(EiDeviceInfo::get_device());
    ATServer *at;
    int err = 0;

    /* output of printf is output immediately without buffering */
    setvbuf(stdout, NULL, _IONBF, 0);

    // /* Switch CPU core clock to 128 MHz */
    nrfx_clock_divider_set(NRF_CLOCK_DOMAIN_HFCLK, NRF_CLOCK_HFCLK_DIV_1);

    /* Initialize board uart */
    if(uart_init() != 0) {
        LOG_ERR("Init uart on board error occured\r\n");
    }

    /* Setup the accelerometer sensor */
    if(ei_inertial_init() == false) {
        LOG_ERR("Light sensor communication error occured");
    }

    // NOTE: This is required so the device ID that is based on BLE MAC is properly initialized
    err = bt_enable(NULL);
    if (err) {
        LOG_ERR("BLE init failed (err %d)\n", err);
    }

    //we have to do this later because the BLE stack is not available on boot
    dev->init_device_id();

    ei_printf("Hello from Edge Impulse\r\n"
              "Compiled on %s %s\r\n", __DATE__, __TIME__);

    at = ei_at_init();

    char ssid[128] = { 0 };
    char password[128] = { 0 };
    int security = 0;

    dev->get_wifi_config(ssid, password, &security);

    if (strlen(ssid) != 0) {
        ei_printf("Connecting to WiFi %s\n", ssid);
        cmd_wifi_connect(ssid, password, security);
        // waithing to connect to wifi
        if(cmd_wifi_connecting() != 0) {
            LOG_ERR("Failed to connect to WiFi\n");
            ei_printf("ERR: Failed to connect to WiFi\n");
        }
        else {
            // waiting to get dhcp config
            if(cmd_dhcp_configured() != 0) {
                LOG_ERR("Failed to configure DHCP\n");
                ei_printf("ERR: Failed to configure DHCP\n");
            }
            else {
                ei_sleep(300);
                LOG_INF("WiFi connected\n");
                ei_printf("WiFi connected\n");
                ei_ws_client_start(dev, nullptr);
            }
        }
    }

    at->print_prompt();
    LOG_INF("Entering infinite loop\n");
    while(1) {
        char data = uart_getchar();

        while(data != 0xFF) {
            if(is_inference_running() && data == 'b') {
                ei_stop_impulse();
                at->print_prompt();
                continue;
            }
            dev->set_serial_channel(UART);
            at->handle(data);
            data = uart_getchar();
        }
        ei_sleep(1);
    }
}
```

## src/ei_at_handlers.cpp
```c
/* The Clear BSD License
 *
 * Copyright (c) 2025 EdgeImpulse Inc.
 * All rights reserved.
 *
 * Redistribution and use in source and binary forms, with or without
 * modification, are permitted (subject to the limitations in the disclaimer
 * below) provided that the following conditions are met:
 *
 *   * Redistributions of source code must retain the above copyright notice,
 *   this list of conditions and the following disclaimer.
 *
 *   * Redistributions in binary form must reproduce the above copyright
 *   notice, this list of conditions and the following disclaimer in the
 *   documentation and/or other materials provided with the distribution.
 *
 *   * Neither the name of the copyright holder nor the names of its
 *   contributors may be used to endorse or promote products derived from this
 *   software without specific prior written permission.
 *
 * NO EXPRESS OR IMPLIED LICENSES TO ANY PARTY'S PATENT RIGHTS ARE GRANTED BY
 * THIS LICENSE. THIS SOFTWARE IS PROVIDED BY THE COPYRIGHT HOLDERS AND
 * CONTRIBUTORS "AS IS" AND ANY EXPRESS OR IMPLIED WARRANTIES, INCLUDING, BUT NOT
 * LIMITED TO, THE IMPLIED WARRANTIES OF MERCHANTABILITY AND FITNESS FOR A
 * PARTICULAR PURPOSE ARE DISCLAIMED. IN NO EVENT SHALL THE COPYRIGHT HOLDER OR
 * CONTRIBUTORS BE LIABLE FOR ANY DIRECT, INDIRECT, INCIDENTAL, SPECIAL,
 * EXEMPLARY, OR CONSEQUENTIAL DAMAGES (INCLUDING, BUT NOT LIMITED TO,
 * PROCUREMENT OF SUBSTITUTE GOODS OR SERVICES; LOSS OF USE, DATA, OR PROFITS; OR
 * BUSINESS INTERRUPTION) HOWEVER CAUSED AND ON ANY THEORY OF LIABILITY, WHETHER
 * IN CONTRACT, STRICT LIABILITY, OR TORT (INCLUDING NEGLIGENCE OR OTHERWISE)
 * ARISING IN ANY WAY OUT OF THE USE OF THIS SOFTWARE, EVEN IF ADVISED OF THE
 * POSSIBILITY OF SUCH DAMAGE.
 */

#include "ei_at_handlers.h"
#include "ei_device_nordic_nrf7002dk.h"
#include "ei_base64_encode.h"
#include "inference/ei_run_impulse.h"
#include "edge-impulse-sdk/porting/ei_classifier_porting.h"
#include "firmware-sdk/at-server/ei_at_command_set.h"
#include "firmware-sdk/at-server/ei_at_server.h"
#include "firmware-sdk/ei_device_info_lib.h"
#include "firmware-sdk/ei_fusion.h"
#include "firmware-sdk/at_base64_lib.h"
#include "firmware-sdk/ei_device_lib.h"
#include "firmware-sdk/ei_device_interface.h"
#include <zephyr/logging/log.h>
#include <zephyr/kernel.h>
#include <string>
#include "wifi/wifi.h"
#include "wifi/ei_ws_client.h"

LOG_MODULE_REGISTER(at_handlers, LOG_LEVEL_DBG);

using namespace std;

static EiDeviceNRF7002DK *dev;

#define TRANSFER_BUF_LEN 32

inline bool check_args_num(const int &required, const int &received)
{
    if(received < required) {
        ei_printf("Too few arguments! Required: %d\n", required);
        return false;
    }

    return true;
}

bool at_get_device_id(void)
{
    ei_printf("%s\n", dev->get_device_id().c_str());

    return true;
}

bool at_set_device_id(const char **argv, const int argc)
{
    if(argc < 1) {
        ei_printf("Missing argument!\n");
        return true;
    }

    dev->set_device_id(argv[0]);

    ei_printf("OK\n");

    return true;
}

bool at_get_upload_host(void)
{
    ei_printf("%s\n", dev->get_upload_host().c_str());

    return true;
}

bool at_set_upload_host(const char **argv, const int argc)
{
    if(argc < 1) {
        ei_printf("Missing argument!\n");
        return true;
    }

    dev->set_upload_host(argv[0]);

    ei_printf("OK\n");

    return true;
}

bool at_get_upload_settings(void)
{
    ei_printf("Api Key:   %s\n", dev->get_upload_api_key().c_str());
    ei_printf("Host:      %s\n", dev->get_upload_host().c_str());
    ei_printf("Path:      %s\n", dev->get_upload_path().c_str());

    return true;
}

bool at_set_upload_settings(const char **argv, const int argc)
{
    if(argc < 2) {
        ei_printf("Missing argument! Required: " AT_UPLOADSETTINGS_ARGS "\n");
        return true;
    }

    //TODO: can we set these values to ""?
    dev->set_upload_api_key(argv[0]);
    dev->set_upload_path(argv[1]);

    ei_printf("OK\n");

    return true;
}

bool at_get_mgmt_url(void)
{
    ei_printf("%s\n", dev->get_management_url().c_str());

    return true;
}

bool at_set_mgmt_url(const char **argv, const int argc)
{
    if(argc < 1) {
        ei_printf("Missing argument!\n");
        return true;
    }

    dev->set_management_url(argv[0]);

    ei_printf("OK\n");

    return true;
}

bool at_get_sample_settings(void)
{
    ei_printf("Label:     %s\n", dev->get_sample_label().c_str());
    ei_printf("Interval:  %.2f ms.\n", dev->get_sample_interval_ms());
    ei_printf("Length:    %lu ms.\n", dev->get_sample_length_ms());
    ei_printf("HMAC key:  %s\n", dev->get_sample_hmac_key().c_str());

    return true;
}

bool at_set_sample_settings(const char **argv, const int argc)
{
    if(argc < 3) {
        ei_printf("Missing argument! Required: " AT_SAMPLESETTINGS_ARGS "\n");
        return true;
    }

    dev->set_sample_label(argv[0]);

    //TODO: sanity check and/or exception handling
    string interval_ms_str(argv[1]);
    dev->set_sample_interval_ms(stof(interval_ms_str));

    //TODO: sanity check and/or exception handling
    string sample_length_str(argv[2]);
    dev->set_sample_length_ms(stoi(sample_length_str));

    if(argc >= 4) {
        dev->set_sample_hmac_key(argv[3]);
    }

    ei_printf("OK\n");

    return true;
}

bool at_clear_config(void)
{
    dev->clear_config();
    dev->init_device_id();
#ifdef CONFIG_WIFI_NRF700X
    if(cmd_wifi_connected()) {
        ei_ws_client_stop();
        cmd_wifi_disconnect();
    }
#endif
    return true;
}

bool at_unlink_file(const char **argv, const int argc)
{
    ei_printf("\n");

    return true;
}

bool at_read_buffer(const char **argv, const int argc)
{
    if(argc < 2) {
        ei_printf("Missing argument! Required: " AT_READBUFFER_ARGS "\n");
        return true;
    }

    size_t start = (size_t)atoi(argv[0]);
    size_t length = (size_t)atoi(argv[1]);

    dev->set_state(eiStateUploading);

    bool use_max_baudrate = false;
    if (argc >= 3 && argv[2][0] == 'y') {
       use_max_baudrate = true;
    }

    if (use_max_baudrate) {
        ei_printf("OK\r\n");
        ei_sleep(100);
        dev->set_max_data_output_baudrate();
        ei_sleep(100);
    }

    bool success = read_encode_send(start, length);

    if (use_max_baudrate) {
        ei_printf("\r\nOK\r\n");
        ei_sleep(100);
        dev->set_default_data_output_baudrate();
        ei_sleep(100);
    }

    if (!success) {
        ei_printf("ERR: Failed to read from buffer\n");
        dev->set_state(eiStateIdle);
    }
    else {
        ei_printf("\n");
        dev->set_state(eiStateFinished);
    }

    return true;
}

bool at_sample_start(const char **argv, const int argc)
{
    EiDeviceNRF7002DK *dev = static_cast<EiDeviceNRF7002DK*>(EiDeviceInfo::get_device());
    dev->set_serial_channel(UART);
    if(argc < 1) {
        ei_printf("Missing sensor name!\n");
        return true;
    }

    const ei_device_sensor_t *sensor_list;
    size_t sensor_list_size;

    dev->get_sensor_list((const ei_device_sensor_t **)&sensor_list, &sensor_list_size);

    for (size_t ix = 0; ix < sensor_list_size; ix++) {
        if (strcmp(sensor_list[ix].name, argv[0]) == 0) {
            if (!sensor_list[ix].start_sampling_cb()) {
                ei_printf("ERR: Failed to start sampling\n");
                dev->set_state(eiStateIdle);
            }
            else {
                dev->set_state(eiStateFinished);
            }
            return true;
        }
    }

    if (ei_connect_fusion_list(argv[0], SENSOR_FORMAT)) {
        if (!ei_fusion_setup_data_sampling()) {
            ei_printf("ERR: Failed to start sensor fusion sampling\n");
            dev->set_state(eiStateIdle);
        }
        else {
            dev->set_state(eiStateFinished);
        }
    }
    else {
        ei_printf("ERR: Failed to find sensor '%s' in the sensor list\n", argv[0]);
    }

    return true;
}

bool at_run_impulse(void)
{
    EiDeviceNRF7002DK *dev = static_cast<EiDeviceNRF7002DK*>(EiDeviceInfo::get_device());
    dev->set_serial_channel(UART);
    ei_start_impulse(false, false);

    return false;
}

bool at_run_impulse_cont(void)
{
    EiDeviceNRF7002DK *dev = static_cast<EiDeviceNRF7002DK*>(EiDeviceInfo::get_device());
    dev->set_serial_channel(UART);
    ei_start_impulse(true, false);

    return false;
}

bool at_run_impulse_static_data(const char **argv, const int argc)
{
    EiDeviceNRF7002DK *dev = static_cast<EiDeviceNRF7002DK*>(EiDeviceInfo::get_device());
    dev->set_serial_channel(UART);
    if (check_args_num(2, argc) == false) {
        return false;
    }

    bool debug = (argv[0][0] == 'y');
    size_t length = (size_t)atoi(argv[1]);

    bool res = run_impulse_static_data(debug, length, TRANSFER_BUF_LEN);

    return res;
}

bool at_stop_impulse(void)
{
    EiDeviceNRF7002DK *dev = static_cast<EiDeviceNRF7002DK*>(EiDeviceInfo::get_device());
    dev->set_serial_channel(UART);
    ei_stop_impulse();

    return true;
}

#ifdef CONFIG_WIFI_NRF700X
bool at_scan_wifi(void)
{
    cmd_wifi_scan();
    cmd_wifi_scan_done();

    return true;
}

bool at_set_wifi(const char **argv, const int argc)
{
    LOG_DBG("set WiFi\n");

    char *endptr;
    int idx = 1;
    static const char* password = NULL;
    unsigned int security = 0;

    if (argc < 1) {
        return -EINVAL;
    }

    /* PSK (optional) */
    if (idx < argc) {
        password = argv[idx];
        idx++;

        if (idx < argc) {
            security = strtol(argv[idx], &endptr, 10);
        }
    } else {
        password = NULL;
        security = 0;
    }

    cmd_wifi_connect(argv[0], password, security);
    //waithing to connect to wifi
    if(cmd_wifi_connecting() < 0) {
        ei_printf("ERR: Failed to connect to WiFi\n");
        return false;
    }
    //waitinhg to connect to dhcp
    if(cmd_dhcp_configured() < 0) {
        ei_printf("ERR: Failed to configure DHCP\n");
        return false;
    }
    ei_ws_client_start(dev, nullptr);
    ei_sleep(100);
    ei_printf("OK\n");

    return true;
}

bool at_get_wifi(void)
{
    char ssid[128] = { 0 };
    char password[128] = { 0 };
    int security = 0;

    dev->get_wifi_config(ssid, password, &security);

    ei_printf("Present:   1\n");
    ei_printf("SSID:      %s\n", ssid);
    ei_printf("Password:  %s\n", password);
    ei_printf("Security:  %d\n", security);
    ei_printf("MAC:       %s\n", dev->get_mac_address().c_str());
    ei_printf("Connected: %d\n", cmd_wifi_connected());

    return true;
}
#endif

bool at_get_config(void)
{
    const ei_device_sensor_t *sensor_list;
    size_t sensor_list_size;

    dev->get_sensor_list((const ei_device_sensor_t **)&sensor_list, &sensor_list_size);

    ei_printf("===== Device info =====\n");
    ei_printf("ID:         %s\n", dev->get_device_id().c_str());
    ei_printf("Type:       %s\n", dev->get_device_type().c_str());
    ei_printf("AT Version: " AT_COMMAND_VERSION "\n");
    ei_printf("Data Transfer Baudrate: %lu\n", dev->get_data_output_baudrate());
    ei_printf("\n");
    ei_printf("===== Sensors ======\n");
    for (size_t ix = 0; ix < sensor_list_size; ix++) {
        ei_printf("Name: %s, Max sample length: %hus, Frequencies: [", sensor_list[ix].name, sensor_list[ix].max_sample_length_s);
        for (size_t fx = 0; fx < EI_MAX_FREQUENCIES; fx++) {
            if (sensor_list[ix].frequencies[fx] != 0.0f) {
                if (fx != 0) {
                    ei_printf(", ");
                }
                ei_printf("%.2fHz", sensor_list[ix].frequencies[fx]);
            }
        }
        ei_printf("]\n");
    }
    ei_built_sensor_fusion_list();
    ei_printf("\n");
    ei_printf("===== WIFI =====\n");
#ifdef CONFIG_WIFI_NRF700X
    at_get_wifi();
#else
    ei_printf("Present:   %d\n", false);
    ei_printf("SSID:      %s\n", "");
    ei_printf("Password:  %s\n", "");
    ei_printf("Security:  %d\n", false);
    ei_printf("MAC:       %s\n", dev->get_mac_address().c_str());
    ei_printf("Connected: %d\n", false);
#endif
    ei_printf("\n");
    ei_printf("===== Sampling parameters =====\n");
    ei_printf("Label:     %s\n", dev->get_sample_label().c_str());
    ei_printf("Interval:  %.2f ms.\n", dev->get_sample_interval_ms());
    ei_printf("Length:    %lu ms.\n", dev->get_sample_length_ms());
    ei_printf("HMAC key:  %s\n", dev->get_sample_hmac_key().c_str());
    ei_printf("\n");
    ei_printf("===== Upload settings =====\n");
    ei_printf("Api Key:   %s\n", dev->get_upload_api_key().c_str());
    ei_printf("Host:      %s\n", dev->get_upload_host().c_str());
    ei_printf("Path:      %s\n", dev->get_upload_path().c_str());
    ei_printf("\n");
    ei_printf("===== Remote management =====\n");
    ei_printf("URL:        %s\n", dev->get_management_url().c_str());
#ifdef CONFIG_WIFI_NRF700X
    bool connected = ei_ws_get_connection_status();
#else
    bool connected = false;
#endif
    ei_printf("Connected: %d\n", connected);
    ei_printf("Last error: \n");
    ei_printf("\n");

    return true;
}

ATServer *ei_at_init(void)
{
    ATServer *at;
    dev = static_cast<EiDeviceNRF7002DK*>(EiDeviceInfo::get_device());

    at = ATServer::get_instance();

    at->register_command(AT_DEVICEID, AT_DEVICEID_HELP_TEXT, nullptr, at_get_device_id, at_set_device_id, AT_DEVICEID_ARGS);
    at->register_command(AT_UPLOADHOST, AT_UPLOADHOST_HELP_TEXT, nullptr, at_get_upload_host, at_set_upload_host, AT_UPLOADHOST_ARGS);
    at->register_command(AT_UPLOADSETTINGS, AT_UPLOADSETTINGS_HELP_TEXT, nullptr, at_get_upload_settings, at_set_upload_settings, AT_UPLOADSETTINGS_ARGS);
    at->register_command(AT_MGMTSETTINGS, AT_MGMTSETTINGS_HELP_TEXT, nullptr, at_get_mgmt_url, at_set_mgmt_url, AT_MGMTSETTINGS_ARGS);
    at->register_command(AT_SAMPLESETTINGS, AT_SAMPLESETTINGS_HELP_TEXT, nullptr, at_get_sample_settings, at_set_sample_settings, AT_SAMPLESETTINGS_ARGS);
    at->register_command(AT_CLEARCONFIG, AT_CLEARCONFIG_HELP_TEXT, at_clear_config, nullptr, nullptr, nullptr);
    at->register_command(AT_UNLINKFILE, AT_UNLINKFILE_HELP_TEXT, nullptr, nullptr, at_unlink_file, AT_UNLINKFILE_ARGS);
    at->register_command(AT_READBUFFER, AT_READBUFFER_HELP_TEXT, nullptr, nullptr, at_read_buffer, AT_READBUFFER_ARGS);
    at->register_command(AT_SAMPLESTART, AT_SAMPLESTART_HELP_TEXT, nullptr, nullptr, at_sample_start, AT_SAMPLESTART_ARGS);
    at->register_command(AT_CONFIG, AT_CONFIG_HELP_TEXT, nullptr, at_get_config, nullptr, nullptr);
    at->register_command(AT_RUNIMPULSE, AT_RUNIMPULSE_HELP_TEXT, at_run_impulse, nullptr, nullptr, nullptr);
    at->register_command(AT_RUNIMPULSECONT, AT_RUNIMPULSECONT_HELP_TEXT, at_run_impulse_cont, nullptr, nullptr, nullptr);
    at->register_command("STOPIMPULSE", "", at_stop_impulse, nullptr, nullptr, nullptr);
    at->register_command(AT_RUNIMPULSESTATIC, AT_RUNIMPULSESTATIC_HELP_TEXT, nullptr, nullptr, at_run_impulse_static_data, AT_RUNIMPULSESTATIC_ARGS);
#ifdef CONFIG_WIFI_NRF700X
    at->register_command(AT_WIFI, AT_WIFI_HELP_TEXT, nullptr, &at_get_wifi, &at_set_wifi, AT_WIFI_ARGS);
    at->register_command(AT_SCANWIFI, AT_SCANWIFI_HELP_TEXT, &at_scan_wifi, nullptr, nullptr, nullptr);
#endif

    return at;
}
```

## src/ei_base64_encode.cpp
```c
/* The Clear BSD License
 *
 * Copyright (c) 2025 EdgeImpulse Inc.
 * All rights reserved.
 *
 * Redistribution and use in source and binary forms, with or without
 * modification, are permitted (subject to the limitations in the disclaimer
 * below) provided that the following conditions are met:
 *
 *   * Redistributions of source code must retain the above copyright notice,
 *   this list of conditions and the following disclaimer.
 *
 *   * Redistributions in binary form must reproduce the above copyright
 *   notice, this list of conditions and the following disclaimer in the
 *   documentation and/or other materials provided with the distribution.
 *
 *   * Neither the name of the copyright holder nor the names of its
 *   contributors may be used to endorse or promote products derived from this
 *   software without specific prior written permission.
 *
 * NO EXPRESS OR IMPLIED LICENSES TO ANY PARTY'S PATENT RIGHTS ARE GRANTED BY
 * THIS LICENSE. THIS SOFTWARE IS PROVIDED BY THE COPYRIGHT HOLDERS AND
 * CONTRIBUTORS "AS IS" AND ANY EXPRESS OR IMPLIED WARRANTIES, INCLUDING, BUT NOT
 * LIMITED TO, THE IMPLIED WARRANTIES OF MERCHANTABILITY AND FITNESS FOR A
 * PARTICULAR PURPOSE ARE DISCLAIMED. IN NO EVENT SHALL THE COPYRIGHT HOLDER OR
 * CONTRIBUTORS BE LIABLE FOR ANY DIRECT, INDIRECT, INCIDENTAL, SPECIAL,
 * EXEMPLARY, OR CONSEQUENTIAL DAMAGES (INCLUDING, BUT NOT LIMITED TO,
 * PROCUREMENT OF SUBSTITUTE GOODS OR SERVICES; LOSS OF USE, DATA, OR PROFITS; OR
 * BUSINESS INTERRUPTION) HOWEVER CAUSED AND ON ANY THEORY OF LIABILITY, WHETHER
 * IN CONTRACT, STRICT LIABILITY, OR TORT (INCLUDING NEGLIGENCE OR OTHERWISE)
 * ARISING IN ANY WAY OUT OF THE USE OF THIS SOFTWARE, EVEN IF ADVISED OF THE
 * POSSIBILITY OF SUCH DAMAGE.
 */

/* Include ----------------------------------------------------------------- */
#include "edge-impulse-sdk/porting/ei_classifier_porting.h"
#include "firmware-sdk/ei_device_info_lib.h"
#include "firmware-sdk/ei_device_memory.h"
#include "firmware-sdk/at_base64_lib.h"
#include "ei_device_nordic_nrf7002dk.h"
#include <zephyr/logging/log.h>
#include <zephyr/drivers/uart.h>
#include <zephyr/kernel.h>
#include <cmath>

LOG_MODULE_REGISTER(base64, LOG_LEVEL_DBG);

bool read_encode_send(size_t address, size_t length)
{
    EiDeviceInfo *dev = EiDeviceInfo::get_device();
    EiDeviceMemory *memory = dev->get_memory();
    // we are encoiding data into base64, so it needs to be divisible by 3
    const int buffer_size = 513;
    uint8_t* buffer = (uint8_t*)ei_malloc(buffer_size);
    if(buffer == nullptr) {
        LOG_ERR("Unable to allocate base64 encoder buffer");
        return false;
    }

    while (1) {
        LOG_DBG("Reading %d bytes from %d", length, address);
        size_t bytes_to_read = buffer_size;

        if (bytes_to_read > length) {
            bytes_to_read = length;
        }

        if (bytes_to_read == 0) {
            ei_free(buffer);
            return true;
        }

        if (memory->read_sample_data(buffer, address, bytes_to_read) != bytes_to_read) {
            ei_free(buffer);
            LOG_ERR("Failed to read samples memory");
            return false;
        }

        base64_encode((char *)buffer, bytes_to_read, ei_putchar);

        address += bytes_to_read;
        length -= bytes_to_read;
    }

    ei_free(buffer);
    return true;
}
```

## src/ei_device_nordic_nrf7002dk.cpp
```c
/* The Clear BSD License
 *
 * Copyright (c) 2025 EdgeImpulse Inc.
 * All rights reserved.
 *
 * Redistribution and use in source and binary forms, with or without
 * modification, are permitted (subject to the limitations in the disclaimer
 * below) provided that the following conditions are met:
 *
 *   * Redistributions of source code must retain the above copyright notice,
 *   this list of conditions and the following disclaimer.
 *
 *   * Redistributions in binary form must reproduce the above copyright
 *   notice, this list of conditions and the following disclaimer in the
 *   documentation and/or other materials provided with the distribution.
 *
 *   * Neither the name of the copyright holder nor the names of its
 *   contributors may be used to endorse or promote products derived from this
 *   software without specific prior written permission.
 *
 * NO EXPRESS OR IMPLIED LICENSES TO ANY PARTY'S PATENT RIGHTS ARE GRANTED BY
 * THIS LICENSE. THIS SOFTWARE IS PROVIDED BY THE COPYRIGHT HOLDERS AND
 * CONTRIBUTORS "AS IS" AND ANY EXPRESS OR IMPLIED WARRANTIES, INCLUDING, BUT NOT
 * LIMITED TO, THE IMPLIED WARRANTIES OF MERCHANTABILITY AND FITNESS FOR A
 * PARTICULAR PURPOSE ARE DISCLAIMED. IN NO EVENT SHALL THE COPYRIGHT HOLDER OR
 * CONTRIBUTORS BE LIABLE FOR ANY DIRECT, INDIRECT, INCIDENTAL, SPECIAL,
 * EXEMPLARY, OR CONSEQUENTIAL DAMAGES (INCLUDING, BUT NOT LIMITED TO,
 * PROCUREMENT OF SUBSTITUTE GOODS OR SERVICES; LOSS OF USE, DATA, OR PROFITS; OR
 * BUSINESS INTERRUPTION) HOWEVER CAUSED AND ON ANY THEORY OF LIABILITY, WHETHER
 * IN CONTRACT, STRICT LIABILITY, OR TORT (INCLUDING NEGLIGENCE OR OTHERWISE)
 * ARISING IN ANY WAY OUT OF THE USE OF THIS SOFTWARE, EVEN IF ADVISED OF THE
 * POSSIBILITY OF SUCH DAMAGE.
 */

/* Include ----------------------------------------------------------------- */
#include <zephyr/kernel.h>
#include <zephyr/drivers/gpio.h>
#include <zephyr/drivers/uart.h>
#include <zephyr/bluetooth/addr.h>
#include <zephyr/bluetooth/bluetooth.h>
#include "ei_device_nordic_nrf7002dk.h"
#include "flash_memory.h"
#include "ei_at_handlers.h"
#include "edge-impulse-sdk/porting/ei_classifier_porting.h"
#include "edge-impulse-sdk/dsp/ei_utils.h"
#include "firmware-sdk/ei_device_memory.h"

#include <zephyr/logging/log.h>
LOG_MODULE_REGISTER(ei_device_NRF7002DK);

/* The devicetree node identifier for the "led0" alias. */
#define LED0_NODE DT_ALIAS(led1)

static const struct gpio_dt_spec led = GPIO_DT_SPEC_GET(LED0_NODE, gpios);

using namespace std;

static void led_timer_handler(struct k_timer *dummy);
static void led_work_handler(struct k_work *work);
static void sampler_timer_handler(struct k_timer *dummy);
static void sampler_work_handler(struct k_work *work);

K_TIMER_DEFINE(led_timer, led_timer_handler, NULL);
K_WORK_DEFINE(led_work, led_work_handler);
K_TIMER_DEFINE(sampler_timer, sampler_timer_handler, NULL);
K_WORK_DEFINE(sampler_work, sampler_work_handler);

void set_max_data_output_baudrate_c(void);
void set_default_data_output_baudrate_c(void);

const struct device *uart;

static void led_work_handler(struct k_work *work)
{
    EiDeviceNRF7002DK *dev = static_cast<EiDeviceNRF7002DK*>(EiDeviceInfo::get_device());
    EiState state =dev->get_state();
    static uint8_t animation = 0;
    static uint8_t blink;

    switch(state)
    {
        case eiStateErasingFlash:
            gpio_pin_set_dt(&led, blink++ % 2);
            break;
        case eiStateSampling:
            gpio_pin_set_dt(&led, blink++ % 2);
            break;
        case eiStateUploading:
            gpio_pin_set_dt(&led, blink++ % 2);
            break;
        case eiStateFinished:
            blink = 0;
            if(animation == 0) {
                animation = 10;
            }
            break;
        default:
            break;
    }

    if(animation == 0) {
        return;
    }

    switch(animation) {
        case 10:
            gpio_pin_set_dt(&led, 0);
            break;
        case 9:
            gpio_pin_set_dt(&led, 1);
            break;
        case 8:
            gpio_pin_set_dt(&led, 0);
            break;
        case 7:
            gpio_pin_set_dt(&led, 1);
            break;
        case 6:
            gpio_pin_set_dt(&led, 0);
            break;
        case 5:
            gpio_pin_set_dt(&led, 1);
            break;
        case 4:
            gpio_pin_set_dt(&led, 0);
            break;
        case 3:
            gpio_pin_set_dt(&led, 1);
            break;
        case 2:
            gpio_pin_set_dt(&led, 0);
            break;
        case 1:
            dev->set_state(eiStateIdle);
            break;
    }
    animation--;
}

static void led_timer_handler(struct k_timer *dummy)
{
    k_work_submit(&led_work);
}

static void sampler_timer_handler(struct k_timer *dummy)
{
    k_work_submit(&sampler_work);
}

static void sampler_work_handler(struct k_work *work)
{
    EiDeviceNRF7002DK *dev = static_cast<EiDeviceNRF7002DK*>(EiDeviceInfo::get_device());

#if MULTI_FREQ_ENABLED == 1

    if (dev->get_fusioning() == 1) {
        dev->sample_read_callback();
    }
    else {
        uint8_t flag = 0;
        uint8_t i = 0;

        // update actual time
        dev->actual_timer += dev->get_sample_interval();

        for (i = 0; i < dev->get_fusioning(); i++){
            if (((uint32_t)(dev->actual_timer % (uint32_t)dev->multi_sample_interval.at(i))) == 0) {   /* check if period of sensor is a multiple of actual time*/
                flag |= (1<<i);                                                                     /* if so, time to sample it! */
            }
        }

        if (dev->sample_multi_read_callback != nullptr){
            dev->sample_multi_read_callback(flag);
        }

    }

#else
    dev->sample_read_callback();
#endif
}

EiDeviceInfo* EiDeviceInfo::get_device(void)
{
    static EiFlashMemory memory(sizeof(EiConfig));
    static EiDeviceNRF7002DK dev(&memory);

    return &dev;
}

EiDeviceNRF7002DK::EiDeviceNRF7002DK(EiDeviceMemory* mem)
{
    EiDeviceInfo::memory = mem;

    load_config();

    int ret = 0;

    if (!gpio_is_ready_dt(&led)) {
        ei_printf("Error: LED GPIO port DT_ALIAS(led1) not available\n");
        LOG_ERR("Cannot init LEDs (err: %d)", ret);
    }

    ret = gpio_pin_configure_dt(&led, GPIO_OUTPUT_INACTIVE);
    if (ret < 0) {
        ei_printf("Error: LED GPIO port DT_ALIAS(led1) not available\n");
        LOG_ERR("Cannot configure LED (err: %d)", ret);
    }

    device_type = "NRF7002DK    ";
}

EiDeviceNRF7002DK::~EiDeviceNRF7002DK()
{

}

void EiDeviceNRF7002DK::init_device_id(void)
{
    bt_addr_le_t addr;
    size_t id_count = 1;
    char temp[18];

    bt_id_get(&addr, &id_count);

    snprintf(temp, 18, "%02X:%02X:%02X:%02X:%02X:%02X",
        addr.a.val[5], addr.a.val[4], addr.a.val[3],
        addr.a.val[2], addr.a.val[1], addr.a.val[0]);

    LOG_INF("Setting ID = %s", temp);

    device_id = string(temp);
    mac_address = string(temp);
    save_config();
}

void EiDeviceNRF7002DK::clear_config(void)
{
    EiDeviceInfo::clear_config();

    init_device_id();
    save_config();
}

string EiDeviceNRF7002DK::get_mac_address(void)
{
    return mac_address;
}

bool EiDeviceNRF7002DK::start_sample_thread(void (*sample_read_cb)(void), float sample_interval_ms)
{
    this->sample_read_callback = sample_read_cb;
#if MULTI_FREQ_ENABLED == 1
    this->actual_timer = 0;
    this->fusioning = 1;
#endif

    k_timer_start(&sampler_timer, K_MSEC(sample_interval_ms), K_MSEC(sample_interval_ms));

    return true;
}

bool EiDeviceNRF7002DK::stop_sample_thread(void)
{
    k_timer_stop(&sampler_timer);

#if MULTI_FREQ_ENABLED == 1
    this->actual_timer = 0;
    this->fusioning = 0;
#endif

    return true;
}

#if MULTI_FREQ_ENABLED == 1
bool EiDeviceNRF7002DK::start_multi_sample_thread(void (*sample_multi_read_cb)(uint8_t), float* multi_sample_interval_ms, uint8_t num_fusioned)
{
    uint8_t i;
    uint8_t flag = 0;

    this->sample_multi_read_callback = sample_multi_read_cb;
    this->fusioning = num_fusioned;

    this->multi_sample_interval.clear();

    for (i = 0; i < num_fusioned; i++){
        this->multi_sample_interval.push_back(1.f/multi_sample_interval_ms[i]*1000.f);
    }

    this->sample_interval = ei_fusion_calc_multi_gcd(this->multi_sample_interval.data(), this->fusioning);

    /* force first reading */
    for (i = 0; i < this->fusioning; i++){
            flag |= (1<<i);
    }
    this->sample_multi_read_callback(flag);

    this->actual_timer = 0;

    k_timer_start(&sampler_timer, K_MSEC(this->sample_interval), K_MSEC(this->sample_interval));

    return true;
}
#endif

void EiDeviceNRF7002DK::set_state(EiState state)
{
    this->state = state;

    gpio_pin_set_dt(&led, 0);


    switch(state) {
        case eiStateErasingFlash:
        case eiStateSampling:
        case eiStateUploading:
        case eiStateFinished:
            k_timer_start(&led_timer, K_MSEC(250), K_MSEC(250));
            break;
        case eiStateIdle:
        default:
            k_timer_stop(&led_timer);
            break;
    }
}

EiState EiDeviceNRF7002DK::get_state(void)
{
    return this->state;
}

void EiDeviceNRF7002DK::set_serial_channel(serial_channel_t chan)
{
    last_channel = chan;
}

serial_channel_t EiDeviceNRF7002DK::get_serial_channel(void)
{
    return last_channel;
}

/**
 * @brief      Set output baudrate to max
 *
 */
void EiDeviceNRF7002DK::set_max_data_output_baudrate()
{
    set_max_data_output_baudrate_c();
}

/**
 * @brief      Set output baudrate to default
 *
 */
void EiDeviceNRF7002DK::set_default_data_output_baudrate()
{
    set_default_data_output_baudrate_c();
}

bool EiDeviceNRF7002DK::get_sensor_list(const ei_device_sensor_t **sensor_list, size_t *sensor_list_size)
{
    // no standalone sensors
    *sensor_list = nullptr;
    *sensor_list_size = 0;
    return true;
}

uint32_t EiDeviceNRF7002DK::get_data_output_baudrate(void)
{
    return MAX_BAUD;
}


int EiDeviceNRF7002DK::set_wifi_config(const char *ssid, const char *password, const int security)
{
    LOG_INF("Setting WiFi config");
    wifi_ssid = (std::string)ssid;
    wifi_password = (std::string)password;
    wifi_security = (EiWiFiSecurity)security;

    LOG_INF("wifi: save_config");
    save_config();

    return 0;
}
int EiDeviceNRF7002DK::get_wifi_config(char *ssid, char *password, int *security)
{
    LOG_INF("Getting WiFi config");
    load_config();

    LOG_INF("config loded");
    LOG_INF("wifi_ssdi: %s", wifi_ssid.c_str());
    LOG_INF("wifi_password: %s", wifi_password.c_str());
    LOG_INF("wifi_security: %d", wifi_security);
    strcpy(ssid, wifi_ssid.c_str());
    strcpy(password, wifi_password.c_str());
    *security = wifi_security;

    return 0;
}

/**
 * @brief      Init development kit UART
 *
 * @return     0 If successful
 * @return     -ENXIO If not successful
 *
 */
int uart_init(void)
{
    int err = 0;

    uart = DEVICE_DT_GET(DT_NODELABEL(uart0));
    if (!uart) {
        return -ENXIO;
    }

    return err;
}

/**
 * @brief      Get char from UART
 *
 * @return     rcv_char If successful
 * @return     0xFF If not successful
 *
 */
char uart_getchar(void)
{
    unsigned char rcv_char;

    if (uart_poll_in(uart, &rcv_char) == 0) {
        return rcv_char;
    }
    else{
        return 0xFF;
    }
}

/**
 * @brief      Get char from UART
 *
 * @param[in] send_char Character to be sent over UART
 *
 */
void ei_putchar(char c)
{
    uart_poll_out(uart, c);
}

void set_max_data_output_baudrate_c(void)
{
    struct uart_config cfg;

    if(uart_config_get(uart, &cfg)) {
        LOG_ERR("ERR: can't get UART config!");
        ei_printf("ERR: can't get UART config!\n");
    }

    cfg.baudrate = MAX_BAUD;

    if(uart_configure(uart, &cfg)) {
        LOG_ERR("ERR: can't set UART config!");
        ei_printf("ERR: can't set UART config!\n");
    }
}

void set_default_data_output_baudrate_c(void)
{
    struct uart_config cfg;

    if (uart_config_get(uart, &cfg)) {
        LOG_ERR("ERR: can't get UART config!");
        ei_printf("ERR: can't get UART config!\n");
    }

    cfg.baudrate = DEFAULT_BAUD;

    if (uart_configure(uart, &cfg)) {
        LOG_ERR("ERR: can't set UART config!");
        ei_printf("ERR: can't set UART config!\n");
    }
}
```
